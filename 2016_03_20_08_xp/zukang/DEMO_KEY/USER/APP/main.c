#include "stm32f10x_conf.h"
#include "stm32f10x_tim.h"
#include "stm32f10x_dac.h"
#include "stm32f10x_dma.h"
#include "delay.h"
#include "gpio_bb.h"
#include "ch452.h"

#include "EZ_GUI.H"

unsigned short sin_[4096] =  {2048, 2051, 2054, 2057, 2060, 2063, 2066, 2069, 2073, 2076, 2079, 2082, 2085,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 2042, 2045} ;
EPEN * pen = 0;

unsigned int  counter_step = 0x10950;
unsigned int    indx = 0;


// /**
//   * @name   SystemInit
//   * @brief  初始化系统时钟
//   * @note   
//   ×   此函数不需要在main函数中调用，在进main函数之前已经由启动文件调用了：
//   ×   LDR     R0, =SystemInit
//   ×   BLX     R0               
//   ×   LDR     R0, =__main
//   ×   BX      R0
//   * @param  无
//   * @retval 无
//   */
void SystemInit(void)
{
  ErrorStatus	err;
  /* Reset RCC */
  RCC_DeInit();
  /* Enable HSE */
  RCC_HSEConfig(RCC_HSE_ON);
  /* Wait till HSE is ready */
  err = RCC_WaitForHSEStartUp();
  if (err == SUCCESS)
  {
    /* Enable Prefetch Buffer */
    FLASH_PrefetchBufferCmd(FLASH_PrefetchBuffer_Enable);
    /* Flash 2 wait state */
    FLASH_SetLatency(FLASH_Latency_2);
    /* HCLK = SYSCLK */
    RCC_HCLKConfig(RCC_SYSCLK_Div1); 
    /* PCLK2 = HCLK */
    RCC_PCLK2Config(RCC_HCLK_Div1); 
    /* PCLK1 = HCLK/2 */
    RCC_PCLK1Config(RCC_HCLK_Div2);
    /* PLLCLK = 8MHz * 9 = 72 MHz */
    RCC_PLLConfig(RCC_PLLSource_HSE_Div1, RCC_PLLMul_9);
    /* Enable PLL */ 
    RCC_PLLCmd(ENABLE);
    /* Wait till PLL is ready */
    while (RCC_GetFlagStatus(RCC_FLAG_PLLRDY) == RESET);
    /* Select PLL as system clock source */
    RCC_SYSCLKConfig(RCC_SYSCLKSource_PLLCLK);
    /* Wait till PLL is used as system clock source */
    while(RCC_GetSYSCLKSource() != 0x08);
  }
  else
  { /* If HSE fails to start-up, the application will have wrong clock configuration.
       User can add here some code to deal with this error */    

    /* Go to infinite loop */
    //while (1)
    //{
    //}
  }
}

void DAC_Configuration(void)

{

  GPIO_InitTypeDef gpio_t;
  DAC_InitTypeDef            DAC_InitStructure;
  gpio_t.GPIO_Mode = GPIO_Mode_AF_PP; 
  gpio_t.GPIO_Pin  = GPIO_Pin_4;
  gpio_t.GPIO_Speed=GPIO_Speed_50MHz; 
  GPIO_Init(GPIOA,&gpio_t);
  DAC_DeInit();
  DAC_InitStructure.DAC_Trigger = DAC_Trigger_None;
  DAC_InitStructure.DAC_WaveGeneration = DAC_WaveGeneration_None;      
  DAC_InitStructure.DAC_OutputBuffer = DAC_OutputBuffer_Enable;
  DAC_Init(DAC_Channel_1, &DAC_InitStructure);
  DAC_Cmd(DAC_Channel_1, ENABLE);
  DAC_SoftwareTriggerCmd(DAC_Channel_1,ENABLE);
}


void delay(unsigned short tim)
{
  unsigned short i = 0;
  for(i = 0; i < tim; i ++);
}

void timer_init()
{
	TIM_TimeBaseInitTypeDef  TIM_TimeBaseStructure;
  NVIC_InitTypeDef         NVIC_InitStruct;

	TIM_DeInit(TIM3);		
	TIM_TimeBaseStructInit(&TIM_TimeBaseStructure);
	TIM_TimeBaseStructure.TIM_Prescaler = 0; 
	TIM_TimeBaseStructure.TIM_Period = 50; 			
	//TIM_TimeBaseStructure.TIM_ClockDivision = TIM_CKD_DIV1; 
	TIM_TimeBaseStructure.TIM_CounterMode = TIM_CounterMode_Up;
	TIM_TimeBaseInit(TIM3, &TIM_TimeBaseStructure);
  TIM_ITConfig(TIM3,TIM_IT_Update,ENABLE);
  NVIC_InitStruct.NVIC_IRQChannel = TIM3_IRQn;
  NVIC_InitStruct.NVIC_IRQChannelSubPriority = 0x0;
  NVIC_InitStruct.NVIC_IRQChannelCmd = ENABLE;
  NVIC_Init(&NVIC_InitStruct);
  TIM_Cmd(TIM3, ENABLE);
}
//  0x000000
void TIM3_IRQHandler()
{
  TIM_ClearFlag(TIM3, TIM_IT_Update);
  DAC_SetChannel1Data(DAC_Align_12b_R,sin_[indx >> 12]);
  DAC_SoftwareTriggerCmd(DAC_Channel_1,ENABLE);
  indx = indx + counter_step;
  indx = indx & 0xffffff;
	//get_data();
}

int main(void)
{
  RCC_APB1PeriphClockCmd(RCC_APB1Periph_DAC, ENABLE);
	RCC_APB1PeriphClockCmd(RCC_APB1Periph_TIM3, ENABLE);
  DAC_Configuration();
	EZ_GUI_Init();
  
	CH452_Init();
	timer_init();
	DAC_SetChannel1Data(DAC_Align_12b_R,1000);
	DAC_SoftwareTriggerCmd(DAC_Channel_1,ENABLE);
	while(1)
	{}
}
